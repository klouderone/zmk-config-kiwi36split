## config/boards/shields/kiwi36/Kconfig.shield
```kconfig
config SHIELD_KIWI36_LEFT
def_bool $(shields_list_contains,kiwi36_left)

config SHIELD_KIWI36_RIGHT
def_bool $(shields_list_contains,kiwi36_right)
```
